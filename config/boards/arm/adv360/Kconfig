## config/boards/arm/adv360/Kconfig
```kconfig
# SPDX-License-Identifier: MIT
config BOARD_ENABLE_DCDC
    bool "Enable DCDC mode"
    select SOC_DCDC_NRF52X
    default y
    depends on BOARD_ADV360_LEFT || BOARD_ADV360_RIGHT

# Mouse Emulation
config CONFIG_ZMK_MOUSE
    bool "Enable mouse emulation features"
    default y
```

## config/west.yml
```yaml
manifest:
  remotes:
    - name: zmkfirmware
      url-base: https://github.com/zmkfirmware
    - name: refil
      url-base: https://github.com/refil
    - name: myfork
      url-base: https://github.com/youmeomeyou
  projects:
    - name: zmk
      remote: myfork
      revision: fix-short-behavior
      import: app/west.yml
  self:
    path: config
```
